#include <Arduino.h>

const PROGMEM byte head_block[35] = {0x01, 0x01, 0x01, 0x01, 0x01, 0x01, 0x01, 0x01, 0x01, 0x01, 0x01, 0x01, 0x01,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 0xff, 0x87};
//const PROGMEM byte head_block[35] = {0x4E, 0x49, 0x43, 0x4F, 0x4C, 0x48, 0x4F, 0x01, 0x01, 0x01, 0x01, 0x01, 0x01,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 0xff, 0x87};
const PROGMEM byte block0[275] = {0x01, 0x01, 0x01, 0x01, 0x01, 0x01, 0x01, 0x01, 0x01, 0x01, 0x01, 0x01, 0x01,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 0x54, 0xa1};
const PROGMEM byte block1[275] = {0x01, 0x01, 0x01, 0x01, 0x01, 0x01, 0x01, 0x01, 0x01, 0x01, 0x01, 0x01, 0x01,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 0x4f, 0x42};
const PROGMEM byte block2[275] = {0x01, 0x01, 0x01, 0x01, 0x01, 0x01, 0x01, 0x01, 0x01, 0x01, 0x01, 0x01, 0x01,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 0x20, 0x74};
const PROGMEM byte block3[158] = {0x01, 0x01, 0x01, 0x01, 0x01, 0x01, 0x01, 0x01, 0x01, 0x01, 0x01, 0x01, 0x01,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 0x0d, 0x03};
const PROGMEM byte end_block[21] = {0x01, 0x01, 0x01, 0x01, 0x01, 0x01, 0x01, 0x01, 0x01, 0x01, 0x01, 0x01, 0x01, 0x01, 0x01, 0x01, 0x3c, 0x5a, 0xff, 0x02, 0x00};

#define BLOCKBUFLEN 320
#define LEDPIN       13
#define DATAOUT       3
#define MOTPIN        4

byte state = 0x00;

void waitus(long int duree) {
    long int depart = micros();
    while(micros()-depart<duree);
}

void toogle_dataout(void) {
  state ^= 0x01;
  digitalWrite(DATAOUT, state);
}

void read_block(byte *block, uint16_t len) {
  for(uint16_t i = 0; i < len; i++) {
    byte w = block[i];
    for(uint8_t j = 0; j < 8; j++) {
      toogle_dataout();
      waitus(395);
      if(w & 0x80) toogle_dataout();
      waitus(395);
      w <<= 1;
    }
  }
  toogle_dataout();
}


void setup() {
  byte blockbuf[BLOCKBUFLEN];

  pinMode(DATAOUT, OUTPUT);
  pinMode(LEDPIN, OUTPUT);
  pinMode(MOTPIN, INPUT_PULLUP);

  // the output DATAOUT must be set to
  // HIGH for the LEP to be detected
  state = 0x01;
  digitalWrite(DATAOUT, state);

  // wait for the MOTOR ON request from
  // the computer on pin MOTPIN
  while(digitalRead(MOTPIN) == HIGH);
  
  digitalWrite(LEDPIN, HIGH);

  delay(2000);

  memcpy_P(blockbuf, head_block, 35);
  read_block(head_block, 35);
  delay(2000);

  memcpy_P(blockbuf, block0, 275);
  read_block(block0, 275);

  memcpy_P(blockbuf, block1, 275);
  read_block(block1, 275);

  memcpy_P(blockbuf, block2, 275);
  read_block(block2, 275);

  memcpy_P(blockbuf, block3, 158);
  read_block(block3, 158);

  memcpy_P(blockbuf, end_block, 21);
  read_block(end_block, 21);
}

void loop() {
  digitalWrite(LEDPIN, LOW);
  delay(100);
  digitalWrite(LEDPIN, HIGH);
  delay(100);
}
